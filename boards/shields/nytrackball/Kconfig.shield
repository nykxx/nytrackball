## boards/shields/nytrackball/Kconfig.shield
```kconfig
# Copyright (c) 2020 Pete Johanson
# SPDX-License-Identifier: MIT

config SHIELD_NYTRACKBALL_LEFT
    def_bool $(shields_list_contains,nytrackball_left)

config SHIELD_NYTRACKBALL_RIGHT
    def_bool $(shields_list_contains,nytrackball_right)
```

## config/west.yml
```yaml
manifest:
  defaults:
    revision: v0.3
  remotes:
    - name: zmkfirmware
      url-base: https://github.com/zmkfirmware
    # Additional modules containing boards/shields/custom code can be listed here as well
    # See https://docs.zephyrproject.org/3.2.0/develop/west/manifest.html#projects
    - name: nykxx
      url-base: https://github.com/nykxx/

  projects:
    - name: zmk
      remote: zmkfirmware
      revision: main
      import: app/west.yml
    - name: zmk-pmw3610-driver
      remote: nykxx
      revision: main

  self:
    path: config
```
